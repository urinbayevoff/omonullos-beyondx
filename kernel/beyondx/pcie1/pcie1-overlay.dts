// SPDX-License-Identifier: GPL-2.0 OR BSD-3-Clause
/*
 * Galaxy S10 5G: PCIe channel 1 (BLK_FSYS0, Gen3 x2, the S5100 5G modem),
 * applied by pcie-exynos9820-ch1.ko itself so the boot image stays as it
 * is. From the stock tree pcie1@13120000 (reg-names elbi phy sysreg dbi pcs
 * config ia) and the beyondx dtbo; the PMU bit is reached by address in the
 * driver, the sysreg is not used by host-v1. Added for OmonullOS, October 2026.
 */
/dts-v1/;
/plugin/;

/ {
	fragment@0 {
		target-path = "/soc@0";
		__overlay__ {
			#address-cells = <1>;
			#size-cells = <1>;

			pcie@13120000 {
				compatible = "omonullos,exynos9820-pcie-ch1";
				reg = <0x13120000 0x1410>,	/* elbi */
				      <0x13150000 0x2000>,	/* phy (PMA) */
				      <0x13140000 0x1000>,	/* pcs: lane 1 at +0x954 */
				      <0x13400000 0x1000>,	/* dbi */
				      <0x13500000 0x1000>,	/* dbi2 (BAR masks): dbi + 0x100000 */
				      <0x13700000 0x1000>,	/* atu: dbi + 0x300000 */
				      <0x11ffe000 0x2000>;	/* config window */
				reg-names = "elbi", "phy", "pcs", "dbi", "dbi2", "atu", "config";
				interrupts = <0 236 4>;		/* GIC SPI 236, level high */
				interrupt-names = "intr";
				#address-cells = <3>;
				#size-cells = <2>;
				device_type = "pci";
				/* stock: 15 MB MEM window, CPU 0x11000000 -> PCI 0x12d00000 */
				ranges = <0x82000000 0x0 0x12d00000 0x11000000 0x0 0xf00000>;
				bus-range = <0x00 0xff>;
				#interrupt-cells = <1>;
				interrupt-map-mask = <0 0 0 0x7>;
				interrupt-map = <0 0 0 1 &pcie1_intc 0>,
						<0 0 0 2 &pcie1_intc 1>,
						<0 0 0 3 &pcie1_intc 2>,
						<0 0 0 4 &pcie1_intc 3>;
				num-lanes = <2>;
				max-link-speed = <3>;

				pcie1_intc: legacy-interrupt-controller {
					interrupt-controller;
					#address-cells = <0>;
					#interrupt-cells = <1>;
				};
			};
		};
	};
};
